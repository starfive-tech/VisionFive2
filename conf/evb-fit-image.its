## conf/linux_microsemi_defconfig
```kconfig
CONFIG_SMP=y
# CONFIG_COMPACTION is not set
CONFIG_HZ_100=y
CONFIG_PCI=y
CONFIG_PCI_DMA_32=y
CONFIG_PCI_DEBUG=y
CONFIG_PCIE_MICROSEMI=y
CONFIG_CROSS_COMPILE="riscv64-unknown-linux-gnu-"
CONFIG_DEFAULT_HOSTNAME="ucbvax"
# CONFIG_CROSS_MEMORY_ATTACH is not set
CONFIG_NAMESPACES=y
CONFIG_BLK_DEV_INITRD=y
# CONFIG_RD_BZIP2 is not set
# CONFIG_RD_LZMA is not set
# CONFIG_RD_XZ is not set
# CONFIG_RD_LZO is not set
# CONFIG_RD_LZ4 is not set
CONFIG_EMBEDDED=y
# CONFIG_BLK_DEV_BSG is not set
CONFIG_PARTITION_ADVANCED=y
# CONFIG_IOSCHED_DEADLINE is not set
CONFIG_NET=y
CONFIG_PACKET=y
CONFIG_UNIX=y
CONFIG_INET=y
# CONFIG_INET_XFRM_MODE_TRANSPORT is not set
# CONFIG_INET_XFRM_MODE_TUNNEL is not set
# CONFIG_INET_XFRM_MODE_BEET is not set
# CONFIG_INET_DIAG is not set
# CONFIG_IPV6 is not set
CONFIG_DEVTMPFS=y
CONFIG_DEVTMPFS_MOUNT=y
# CONFIG_FIRMWARE_IN_KERNEL is not set
CONFIG_EXTRA_FIRMWARE="radeon/BTC_rlc.bin radeon/CAICOS_mc.bin radeon/CAICOS_me.bin radeon/CAICOS_pfp.bin radeon/CAICOS_smc.bin radeon/SUMO_uvd.bin"
CONFIG_MTD=y
CONFIG_MTD_BLOCK_RO=y
CONFIG_MTD_M25P80=y
CONFIG_MTD_SPI_NOR=y
CONFIG_EEPROM_AT24=y
CONFIG_BLK_DEV_SD=y
CONFIG_ATA=y
CONFIG_SATA_AHCI=y
CONFIG_SATA_SIL24=y
CONFIG_SATA_MV=y
CONFIG_NETDEVICES=y
CONFIG_MACB=y
CONFIG_E1000E=y
CONFIG_R8169=y
CONFIG_MICROSEMI_PHY=y
CONFIG_INPUT_MOUSEDEV=y
# CONFIG_INPUT_KEYBOARD is not set
# CONFIG_INPUT_MOUSE is not set
# CONFIG_HW_RANDOM is not set
CONFIG_I2C_OCORES=y
CONFIG_SPI=y
CONFIG_SPI_SIFIVE=y
CONFIG_GPIOLIB=y
CONFIG_GPIO_SYSFS=y
CONFIG_GPIO_SIFIVE=y
CONFIG_POWER_RESET=y
CONFIG_POWER_RESET_GPIO_RESTART=y
CONFIG_PMBUS=y
CONFIG_DRM=y
CONFIG_DRM_RADEON=y
# CONFIG_VGA_CONSOLE is not set
CONFIG_FRAMEBUFFER_CONSOLE=y
CONFIG_LOGO=y
CONFIG_USB=y
CONFIG_USB_XHCI_HCD=y
CONFIG_USB_EHCI_HCD=y
CONFIG_USB_STORAGE=y
CONFIG_MMC=y
CONFIG_MMC_SPI=y
CONFIG_NEW_LEDS=y
CONFIG_LEDS_CLASS=y
CONFIG_LEDS_PWM=y
CONFIG_LEDS_TRIGGERS=y
CONFIG_LEDS_TRIGGER_MTD=y
CONFIG_LEDS_TRIGGER_HEARTBEAT=y
CONFIG_LEDS_TRIGGER_PANIC=y
CONFIG_CLK_U54_PRCI=y
CONFIG_CLK_GEMGXL_MGMT=y
# CONFIG_IOMMU_SUPPORT is not set
CONFIG_PWM=y
CONFIG_PWM_SIFIVE=y
CONFIG_NVMEM_SIFIVE_U500_OTP=y
CONFIG_EXT3_FS=y
# CONFIG_FILE_LOCKING is not set
# CONFIG_DNOTIFY is not set
# CONFIG_INOTIFY_USER is not set
# CONFIG_PROC_PAGE_MONITOR is not set
CONFIG_TMPFS=y
# CONFIG_MISC_FILESYSTEMS is not set
# CONFIG_NETWORK_FILESYSTEMS is not set
CONFIG_CMDLINE_BOOL=y
CONFIG_CMDLINE="earlyprintk video=640x480"
CONFIG_PRINTK_TIME=y
CONFIG_STRIP_ASM_SYMS=y
CONFIG_DEBUG_SECTION_MISMATCH=y
CONFIG_STACKTRACE=y
# CONFIG_CRYPTO_HW is not set
```

## conf/u74_nvdla-uboot-fit-image.its
```
/dts-v1/;

/ {
        description = "U-boot FIT image for HiFive Nvdla";
        #address-cells = <2>;

        images {
                vmlinux {
                        description = "vmlinux";
                        data = /incbin/("../work/linux/arch/riscv/boot/Image");
                        type = "kernel";
                        arch = "riscv";
                        os = "linux";
                        load = <0x0 0x80200000>;
                        entry = <0x0 0x80200000>;
                        compression = "none";
                };

                ramdisk {
                        description = "buildroot initramfs";
                        data = /incbin/("../work/initramfs.cpio.gz");
                        type = "ramdisk";
                        arch = "riscv";
                        os = "linux";
                        load = <0x0 0x86100000>;
                        compression = "none";
                        hash-1 {
                                algo = "sha256";
                        };
                };

                fdt {
                        data = /incbin/("../work/u-boot/arch/riscv/dts/starfive_vic7100_evb.dtb");
                        type = "flat_dt";
                        arch = "riscv";
                        load = <0x0 0x86000000>;
                        compression = "none";
                        hash-1 {
                                algo = "sha256";
                        };
                };
        };

        configurations {
                default = "config-1";

                config-1 {
                        description = "HiFive Nvdla with opensbi";
			kernel = "vmlinux";
                        fdt = "fdt";
                        loadables = "ramdisk";
                };
        };
};
```

## conf/uboot-fit-image.its
```
/dts-v1/;

/ {
        description = "U-boot FIT image for HiFive Unleashed";
        #address-cells = <2>;

        images {
                bbl {
                        description = "BBL/SBI/riscv-pk";
                        data = /incbin/("../work/bbl.bin");
                        type = "kernel";
                        arch = "riscv";
                        os = "linux";
                        load = <0x80000000>;
                        entry = <0x80000000>;
                        compression = "none";
                        hash-1 {
                                algo = "sha256";
                        };
                };

                kernel {
                        description = "Linux kernel";
                        data = /incbin/("../work/vmlinux.bin");
                        type = "kernel";
                        arch = "riscv";
                        os = "linux";
                        load = <0x80200000>;
                        compression = "none";
                        hash-1 {
                                algo = "sha256";
                        };
                };

                ramdisk {
                        description = "buildroot initramfs";
                        data = /incbin/("../work/initramfs.cpio.gz");
                        type = "ramdisk";
                        arch = "riscv";
                        os = "linux";
                        load = <0x82000000>;
                        compression = "gzip";
                        hash-1 {
                                algo = "sha256";
                        };
                };

                fdt {
                        data = /incbin/("../work/u-boot/arch/riscv/dts/hifive_u540.dtb");
                        type = "flat_dt";
                        arch = "riscv";
                        load = <0x81f00000>;
                        compression = "none";
                        hash-1 {
                                algo = "sha256";
                        };
                };
        };

        configurations {
                default = "config-1";

                config-1 {
                        description = "HiFive Unleashed with BBL";
                        kernel = "bbl";
                        fdt = "fdt";
                        loadables = "kernel", "ramdisk";
                };
        };
};
```

## conf/visionfive2-fit-image.its
```
/dts-v1/;

/ {
        description = "U-boot FIT image for visionfive2";
        #address-cells = <2>;

        images {
                vmlinux {
                        description = "vmlinux";
                        data = /incbin/("../work/linux/arch/riscv/boot/Image.gz");
                        type = "kernel";
                        arch = "riscv";
                        os = "linux";
                        load = <0x0 0x40200000>;
                        entry = <0x0 0x40200000>;
                        compression = "gzip";
                };

                ramdisk {
                        description = "buildroot initramfs";
                        data = /incbin/("../work/initramfs.cpio.gz");
                        type = "ramdisk";
                        arch = "riscv";
                        os = "linux";
                        load = <0x0 0x46100000>;
                        compression = "none";
                };

                fdt {
                        data = /incbin/("../work/linux/arch/riscv/boot/dts/starfive/jh7110-starfive-visionfive-2-v1.3b.dtb");
                        type = "flat_dt";
                        arch = "riscv";
                        load = <0x0 0x46000000>;
                        compression = "none";
                        hash-1 {
                                algo = "sha256";
                        };
                };
        };

        configurations {
                default = "config-1";

                config-1 {
                        description = "visionfive2 with opensbi";
						kernel = "vmlinux";
                        fdt = "fdt";
                        loadables = "ramdisk";
                };
        };
};
```
