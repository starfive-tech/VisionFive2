## conf/visionfive2-uboot-fit-image.its
```
/dts-v1/;

/ {
	description = "U-boot-spl FIT image for JH7110 VisionFive2";
	#address-cells = <2>;

	images {
		firmware {
			description = "u-boot";
			data = /incbin/("../work/opensbi/platform/generic/firmware/fw_payload.bin");
			type = "firmware";
			arch = "riscv";
			os = "u-boot";
			load = <0x0 0x40000000>;
			entry = <0x0 0x40000000>;
			compression = "none";
		};

		fdt {
			data = /incbin/("../work/u-boot/arch/riscv/dts/starfive_visionfive2.dtb");
			type = "flat_dt";
			arch = "riscv";
			load = <0x40400000>;
			compression = "none";
		};

		fdt-lite {
			data = /incbin/("../work/u-boot/arch/riscv/dts/starfive_visionfive2_lite.dtb");
			type = "flat_dt";
			arch = "riscv";
			load = <0x40400000>;
			compression = "none";
		};
	};

	configurations {
		default = "config-default";

		config-default {
			description = "StarFive VisionFive V2";
			firmware = "firmware";
			fdt = "fdt";
		};

		config-lite {
			description = "StarFive VisionFive V2 Lite";
			firmware = "firmware";
			fdt = "fdt-lite";
		};
	};
};
```
